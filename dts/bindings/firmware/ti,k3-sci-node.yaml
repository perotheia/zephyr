## dts/bindings/mbox/ti,omap-mailbox.yaml
```yaml
# Copyright 2024 Texas Instruments Incorporated.
# SPDX-License-Identifier: Apache-2.0

description: TI OMAP MAILBOX

compatible: "ti,omap-mailbox"

include: [base.yaml, mailbox-controller.yaml]

properties:
  reg:
    required: true

  interrupts:
    required: true

  usr-id:
    type: int
    required: true
    description: User ID for processor

  ti,sci-ir-route:
    type: array
    description: |
      <interrupt-router-device input output>: the NAVSS interrupt router hop
      that connects this mailbox user's interrupt to the VIM line in
      "interrupts". Programmed at boot with TI-SCI (SOC_TI_K3_TISCI_IR_ROUTE).

mbox-cells:
  - channel
```

## soc/ti/k3/Kconfig
```kconfig
# Copyright (c) 2023 Enphase Energy
# Copyright (c) 2024 Nordic Semiconductor ASA
# Copyright (c) 2026 Siemens Mobility GmbH
# SPDX-License-Identifier: Apache-2.0

if SOC_FAMILY_TI_K3

rsource "*/Kconfig"

config SOC_PART_NUMBER
	default "AM2434" if SOC_AM2434_M4 || SOC_AM2434_R5F0_0
	default "AM6232" if SOC_AM6232_A53 || SOC_AM6232_M4
	default "AM6234" if SOC_AM6234_A53 || SOC_AM6234_M4
	default "AM6254" if SOC_AM6254_A53 || SOC_AM6254_M4
	default "AM62L3" if SOC_AM62L3_A53
	default "AM6442" if SOC_AM6442_M4 || SOC_AM6442_R5F0_0 || SOC_AM6442_R5F0_1 || SOC_AM6442_R5F1_0 || SOC_AM6442_R5F1_1
	default "J721e" if SOC_J721E_MAIN_R5F0_0 || SOC_J721E_MAIN_R5F0_1 || \
		SOC_J721E_MAIN_R5F1_0 || SOC_J721E_MAIN_R5F1_1 || \
		SOC_J721E_MCU_R5F0_0 || SOC_J721E_MCU_R5F0_1

config SOC_FAMILY_TI_K3_BOOT_SPRINGBOARD
	def_bool ($(dt_chosen_reg_addr_hex,$(DT_CHOSEN_Z_SRAM)) >= 0x80000000)
	depends on SOC_SERIES_AM64X_R5 || SOC_SERIES_J721E_R5 || SOC_SERIES_J722S_R5
	help
	  If Zephyr code area is in DRAM which is MPU protected from execution
	  by default then this option enables a boot springboard in ATCM to set
	  executable permissions before jumping to the code area in DRAM

config SOC_TI_K3_R5F_EARLY_MPU
	bool "TI's reference R5F MPU table at early boot"
	default y
	depends on SOC_SERIES_J721E_R5 && SOC_FAMILY_TI_K3_BOOT_SPRINGBOARD && !ARM_MPU
	select SOC_PREP_HOOK
	help
	  The boot springboard leaves the MPU enabled with a single region over
	  DRAM that is inner non-cacheable, so code, data and stacks in DRAM run
	  uncached whatever the cache enables (about 50x slower than TI's
	  FreeRTOS on the same core). ARM_MPU cannot simply reprogram it: its
	  init disables the MPU while executing from DRAM, which the default
	  memory map makes execute-never.

	  This programs TI's reference table (PDK r5f_mpu_j721e_default.c) in
	  the SoC prep hook with the MPU kept enabled, from the highest region
	  down, so that DRAM stays executable throughout: a 4 GB strongly-ordered
	  XN background, ATCM, OCSRAM, MSMC and all of DDR write-back
	  write-allocate, BTCM non-cacheable, the shared vring area XN, and a
	  non-cacheable XN window over the IPC shared memory (chosen
	  zephyr,ipc_shm), as normal memory so unaligned copies work.

config SOC_TI_K3_R5F_IPC_WINDOW_SIZE
	hex "Size of the non-cacheable IPC window"
	default 0x200000
	depends on SOC_TI_K3_R5F_EARLY_MPU
	help
	  Power of two; covers the vrings and the resource table/trace that
	  follow the IPC shared memory (TI: 2 MB per core).

config SOC_TI_K3_TISCI_POLLED
	bool
	depends on SOC_SERIES_J721E_R5
	help
	  A minimal TI-SCI client polled over the secure proxy, for the SoC
	  services below. This core's secure proxy threads can be beyond the
	  range of the generic secure proxy driver, and its response interrupt
	  would itself need routing.

if SOC_TI_K3_TISCI_POLLED

config SOC_TI_K3_TISCI_HOST_ID
	int "TI-SCI host id (non-secure context of this core)"
	default 40 if SOC_J721E_MAIN_R5F1_0

config SOC_TI_K3_TISCI_RX_THREAD
	int "Secure proxy thread for TI-SCI responses"
	default 81 if SOC_J721E_MAIN_R5F1_0

config SOC_TI_K3_TISCI_TX_THREAD
	int "Secure proxy thread for TI-SCI requests (low priority)"
	default 83 if SOC_J721E_MAIN_R5F1_0

config SOC_TI_K3_TISCI_SECPROXY_DATA
	hex "Secure proxy target data base"
	default 0x32c00000 if SOC_SERIES_J721E_R5

config SOC_TI_K3_TISCI_SECPROXY_RT
	hex "Secure proxy real-time (thread status) base"
	default 0x32400000 if SOC_SERIES_J721E_R5

endif # SOC_TI_K3_TISCI_POLLED

DT_COMPAT_TI_OMAP_MCSPI := ti,omap-mcspi
DT_PROP_TI_SCI_DEV_ID := ti,sci-dev-id

config SOC_TI_K3_TISCI_DEVICES
	bool "Power on devices with a ti,sci-dev-id property through TI-SCI"
	default y
	depends on SOC_J721E_MAIN_R5F1_0
	depends on $(dt_compat_any_has_prop,$(DT_COMPAT_TI_OMAP_MCSPI),$(DT_PROP_TI_SCI_DEV_ID))
	select SOC_TI_K3_TISCI_POLLED
	help
	  Before their drivers start, request the enabled devices that carry a
	  ti,sci-dev-id property (McSPI so far) on with TI-SCI SET_DEVICE, as
	  TI's PDK does with Sciclient_pmSetModuleState(). Peripherals that no
	  other host has requested are powered off by the system firmware.

DT_COMPAT_TI_OMAP_MAILBOX := ti,omap-mailbox
DT_PROP_TI_SCI_IR_ROUTE := ti,sci-ir-route

config SOC_TI_K3_TISCI_IR_ROUTE
	bool "Route mailbox interrupts through the NAVSS interrupt router with TI-SCI"
	default y
	depends on SOC_J721E_MAIN_R5F1_0
	depends on $(dt_compat_any_has_prop,$(DT_COMPAT_TI_OMAP_MAILBOX),$(DT_PROP_TI_SCI_IR_ROUTE))
	select SOC_TI_K3_TISCI_POLLED
	help
	  For each enabled ti,omap-mailbox node with a ti,sci-ir-route property
	  (<interrupt-router-device input output>), program that router hop at
	  boot with TI-SCI RM_IRQ_SET, as TI's PDK sciclient does. The router
	  output is wired to the node's VIM line.

endif # SOC_FAMILY_TI_K3
```
